/**
 * @cliArgs --board "/boards/LAUNCHXL_F28379D" --device "F2837xD" --part "F2837xD_337ZWT" --package "F2837xD_337ZWT" --context "CPU1" --product "C2000WARE@5.04.00.00"
 * @versions {"tool":"1.27.1+4634"}
 */

/**
 * Import the modules used in this configuration.
 */
const adc       = scripting.addModule("/driverlib/adc.js", {}, false);
const adc1      = adc.addInstance();
const cputimer  = scripting.addModule("/driverlib/cputimer.js", {}, false);
const cputimer1 = cputimer.addInstance();
const dac       = scripting.addModule("/driverlib/dac.js", {}, false);
const dac1      = dac.addInstance();

/**
 * Write custom configuration values to the imported modules.
 */
adc1.enabledSOCs       = ["ADC_SOC_NUMBER0"];
adc1.soc0Channel       = "ADC_CH_ADCIN2";
adc1.soc0SampleWindow  = 15;
adc1.adcClockPrescaler = "ADC_CLK_DIV_4_0";
adc1.$name             = "ADC0";
adc1.soc0Trigger       = "ADC_TRIGGER_CPU1_TINT1";

cputimer1.$name                    = "myCPUTIMER1";
cputimer1.cputimerBase             = "CPUTIMER1_BASE";
cputimer1.enableInterrupt          = true;
cputimer1.registerInterrupts       = true;
cputimer1.startTimer               = true;
cputimer1.emulationMode            = "CPUTIMER_EMULATIONMODE_RUNFREE";
cputimer1.timerPeriod              = 19999;
cputimer1.timerInt.enableInterrupt = true;

dac1.$name            = "DAC0";
dac1.enableOutput     = true;
dac1.referenceVoltage = "DAC_REF_ADC_VREFHI";
